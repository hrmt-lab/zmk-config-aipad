## boards/shields/aipad/Kconfig.defconfig
```kconfig
if SHIELD_AIPAD

config ZMK_KEYBOARD_NAME
    default "aipad"

config AIPAD_DISPLAY_SELFTEST
    bool "Draw a boot self test on every ScreenKey"
    default n
    help
      Bring-up aid. Without it, all four ScreenKeys are intentionally dark until
      the host sends an AI client state, which is indistinguishable from broken
      wiring. With it, every screen lights its backlight and draws a logo and a
      full border right after init, independent of the host: even screens show
      the Codex logo in a blue border and odd screens the Claude Code logo in a
      green border, so neighbouring panels are always distinguishable and the
      physical order of CS1..CS4 can be read off the board. A host update still
      takes over normally. Turn this off once the hardware is confirmed.

config AIPAD_ENCODER_PROBE
    bool "Log the live level of the FPC pins the encoder could be on"
    default n
    help
      Bring-up aid for a rotary encoder that does not respond. Every pin on the
      24 way FPC is accounted for by the matrix, the panels or the backlight, so
      the encoder has to be on one of the few pins left over. This samples those
      pins and logs a line whenever one changes: turn the knob and the two that
      toggle together are the encoder, without putting a meter on 0.5 mm pads.
      P0.05 is one candidate pin, but CONFIG_GPIO_HOGS=n alone no longer
      exposes it now that &spi3 is enabled: the SPIM peripheral's own
      pinctrl state drives that pin whenever spi3 is enabled, independent of
      the boot-time GPIO hog and of AIPAD_STATUS_LED (which only turns the
      LED rendering logic on or off, not the spi3 devicetree node). Disable
      &spi3 in the overlay to see P0.05 in this probe.

config AIPAD_STATUS_LED
    bool "Drive the WS2812B status indicator"
    default y
    help
      Renders AI client state on the four WS2812B LEDs (aipad_leds, chained
      on spi3): a yellow blink while waiting on the user's approval, a
      breathing orange while waiting on the user's input, a red blink on
      error, a steady green held for SCREENKEY_COMPLETED_HOLD_MS (15 s) when
      a session finishes, and off otherwise. Approval and error share the
      same blink rate and are told apart by colour; the completion green is
      the same colour the finished border is drawn in and goes dark together
      with it. All four LEDs always show the same thing;
      the chain acts as one indicator, not four independent ones.
      Disabling this leaves the spi3 and ws2812 devicetree nodes in place,
      so P0.05 is still held low by the SPIM pinctrl state and the chain
      stays dark rather than floating.

config AIPAD_STATUS_LED_SELFTEST
    bool "Flash a boot self test on the WS2812B status indicator"
    default n
    depends on AIPAD_STATUS_LED
    help
      Bring-up aid. Right after boot, walks red -> green -> blue down the
      chain starting from the first LED, confirming wiring, chain order,
      colour order (GRB) and bit timing all in one look. Independent of
      CONFIG_AIPAD_DISPLAY_SELFTEST, so the LEDs can be checked on their own
      without also waiting through the 12 second backlight beacon and the
      8 second pin walk.

endif
```

## config/west.yml
```yaml
manifest:
  defaults:
    revision: main
  remotes:
    - name: zmkfirmware
      url-base: https://github.com/zmkfirmware
    - name: hrmt-lab
      url-base: https://github.com/hrmt-lab
  projects:
    - name: zmk
      remote: zmkfirmware
      revision: main
      import: app/west.yml
    - name: zmk-raw-hid
      remote: hrmt-lab
      revision: custom/raw-hid-custom
    - name: zmk-rawhid-app
      remote: hrmt-lab
      revision: main
  self:
    path: config
```
